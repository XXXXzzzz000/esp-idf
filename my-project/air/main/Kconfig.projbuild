## my-project/air/main/Kconfig.projbuild
```kconfig
menu "Air Project Configuration"

config STORE_HISTORY
    bool "Store command history in flash"
    default y
    help
        Linenoise line editing library provides functions to save and load
        command history. If this option is enabled, initalizes a FAT filesystem
        and uses it to store command history.

config WIFI_SSID
    string "WiFi SSID"
    default "X-elerator"
    help
        SSID (network name) for the example to connect to.

config WIFI_PASSWORD
    string "WiFi Password"
    default "sz12345678"
    help
        WiFi password (WPA or WPA2) for the example to use.
endmenu
```

## my-project/simple_wifi/main/Kconfig.projbuild
```kconfig
menu "Example Configuration"

choice ESP_WIFI_MODE
    prompt "AP or STA"
    default ESP_WIFI_IS_STATION
    help
        Whether the esp32 is softAP or station.

config ESP_WIFI_IS_SOFTAP
    bool "SoftAP"
config ESP_WIFI_IS_STATION
    bool "Station"
endchoice

config ESP_WIFI_MODE_AP
    bool
    default y if ESP_WIFI_IS_SOFTAP
    default n if ESP_WIFI_IS_STATION

config ESP_WIFI_SSID
    string "WiFi SSID"
    default "X-elerator"
    help
	SSID (network name) for the example to connect to.

config ESP_WIFI_PASSWORD
    string "WiFi Password"
    default "sz12345678"
    help
	WiFi password (WPA or WPA2) for the example to use.

config MAX_STA_CONN
    int "Max STA conn"
    default 4
    help
	Max number of the STA connects to AP.

config SERVER_IP
    string "server ip"
    default "172.16.20.93"
    help
	null

config SERVER_PORT
    string "server port"
    default "9999"
    help
	null
endmenu
```
